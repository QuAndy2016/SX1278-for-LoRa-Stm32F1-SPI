/**********************(C) COPYRIGHT tongxinmao.com*****************************
* 文件名			: main.c
* 作者            	: 10152203@qq.COM
* 创建日期          : 2016.3.5
* 描述				: 主文件	STM32F103C8T6+RF（SI443 SI4463 SX1278扩频）+OLED+串口+按键+温湿度传感器
* 历史记录          : 暂无
* 使用说明			：按键S1 短按切换无线是否应答，长按清空收发计数  S2：单次发送  S3:连续发送50*n次
					  发送的数据为温湿度数据，接收方收到后显示
********************************************************************************/

/*--------------------------- 头文件包含 --------------------------------------*/
#include <stdio.h>
#include <stdlib.h>
#include <string.h>
#include "main.h"

#include "usart1.h"
#include "gpio.h"
#include "Delay.h"
#include "timeget.h"
#include "rf.h"
 
/*-----------------------------------------------------------------------------*/
/*
 * #pragma diag_suppress 77,550,1294,1295
 * #pragma diag_suppress 870
 */
#pragma diag_suppress 870
/*
 * ------------------------------------------------------------------------
 * ------------------------------------------------------------------------
 * --------------------         宏定义	      ------------------------------
 * ------------------------------------------------------------------------
 * ------------------------------------------------------------------------
 */

#define CMD_TEMP_HUM	1
#define CMD_ACK			2


/*
 * ------------------------------------------------------------------------
 * ------------------------------------------------------------------------
 * --------------------       变量定义	      ------------------------------
 * ------------------------------------------------------------------------
 * ------------------------------------------------------------------------
 */
u16 Counter=0,Msec=0;
u8 Counterflg=0;

/*
 * ------------------------------------------------------------------------
 * ------------------------------------------------------------------------
 * --------------------       函数声明	      ------------------------------
 * ------------------------------------------------------------------------
 * ------------------------------------------------------------------------
 */


/**************************************************************
 * 函数名  : main()
 * 描述    : 主函数
 *************************************************************/
int main( void )
{
		char buf[64] = "";
	/* --配置系统主频为72MHz */
	SystemInit();
	Delay_InitConfig( 72 );


	GPIOInit();	    //GPIO初始化

	Uart1Init();	//串口初始化用于输出调试信息 9600bps 8N1

	TIM3_Int_Init(9999,7199);	
	RFInit();	 //射频模块初始化
	RFRxMode();	 //进入接收模式
/*发送程序*/
	 
	/*while ( 1 )
	{	
		
			if(Counterflg==1)	
			{	
						Counterflg=0;		
						sendBuf[0]	= Msec;
						sendBuf[1]	= 0;
						RFSendData( sendBuf, 2 );	
						sprintf( buf, "发送 %d SEC %d", iSend, Msec );	
						printf(" 发送计数：%d,当前秒数：%d",iSend,Msec);
						printf("\r\n");
				
			}
		}*/
		/*接收程序*/
	while ( 1 )
	{
		int len;
		
	if(Counterflg==1)	
		{		
			Counterflg=0;	
		}
		
		len = RFRevData( revBuf );	  //接收无线数据
		if ( len > 0 )
		{
	
			sprintf( buf, "收到 %d  SEC %d", iRev, revBuf[0] );	

		}
		
	}
}

/* end of main.c -------------------------------------------------------------*/

